/dts-v1/;

/plugin/;

/ {
        compatible = "brcm,bcm2711";

        fragment@0{

                target = <&i2c_arm>;

                __overlay__

                {
                        #address-cells = <1>;
			#size-cells = <0>;
                        status = "okay";
                        temp_sensor: temp_sensor
                        {
                                compatible = "jaesun,lm75a";
                                reg = <0x40>;
                        };

                };

        }; 
};